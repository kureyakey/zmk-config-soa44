## config/west.yml
```yaml
manifest:
  remotes:
    - name: zmkfirmware
      url-base: https://github.com/zmkfirmware
    - name: petejohanson  # <-- badjeff から petejohanson に変更
      url-base: https://github.com/petejohanson
    - name: caksoylar
      url-base: https://github.com/caksoylar  
  projects:
    - name: zmk
      remote: zmkfirmware
      revision: main
      import: app/west.yml
    - name: zmk-pmw3610-driver
      remote: petejohanson  # <-- 変更
      revision: main       # <-- 最新のZephyr 4.1.0対応コードを掴みにいきます
    - name: zmk-rgbled-widget
      remote: caksoylar
      revision: main
  self:
    path: config
```
